#include <SPI.h>
#include <Wire.h>
#include <Adafruit_GFX.h>
#include <Adafruit_SSD1306.h>

#define SCREEN_WIDTH 128 // OLED display width, in pixels
#define SCREEN_HEIGHT 64 // OLED display height, in pixels

#define OLED_RESET     -1 // Reset pin # (or -1 if sharing Arduino reset pin)
#define SCREEN_ADDRESS 0x3C ///< See datasheet for Address; 0x3D for 128x64, 0x3C for 128x32
Adafruit_SSD1306 display(SCREEN_WIDTH, SCREEN_HEIGHT, &Wire, OLED_RESET);

// 'kingcharlescypher', 128x64px
// inverted bits
const unsigned char epd_bitmap_kingcharlescypher [] PROGMEM = {
  0x00, 0x00, 0x00, 0x00, 0x00, 0x00, 0x00, 0x00, 0x00, 0x00, 0x00, 0x00, 0x00, 0x00, 0x00, 0x00, 
  0x00, 0x00, 0x00, 0x00, 0x00, 0x00, 0x00, 0x00, 0x00, 0x00, 0x00, 0x00, 0x00, 0x00, 0x00, 0x00, 
  0x00, 0x00, 0x00, 0x00, 0x00, 0x00, 0x00, 0x00, 0x00, 0x00, 0x00, 0x00, 0x00, 0x00, 0x00, 0x00, 
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  0x00, 0x00, 0x00, 0x00, 0x00, 0x00, 0x00, 0x00, 0x00, 0x00, 0x00, 0x00, 0x00, 0x00, 0x00, 0x00
};

const int startPins[] = {
    2, 3, 4, 5, 6, 7, 8
}; 

const int endPins[] = {
    9, 10, 11, 12, A1, A2, A3
}; 

const int switchPin = A0;

const int pinCount = 7;

int cycles = 0;

bool isShorted() {
  bool shorted = false;
  char strbuf [50];
  for (int i = 0; i < pinCount - 1; i++) {
    // Check start pin
    int currentStartPin = startPins[i];
    pinMode(currentStartPin, OUTPUT);
    digitalWrite(currentStartPin, LOW);
    for (int j = i + 1 ; j < pinCount; j++) {
      pinMode(startPins[j], INPUT_PULLUP);
      int value = digitalRead(startPins[j]);
      if (value == LOW) {
        sprintf(strbuf, "Start Pin %d is shorted to %d", currentStartPin, startPins[j]);    
        Serial.println(strbuf); 
        //Serial.println("Pin ", startPins[j], " is shorted.")
        shorted = true;
        break;
      }
    }
    pinMode(currentStartPin, INPUT_PULLUP);
    if (shorted) {
      break;
    }
    // Check end pin
    int currentEndPin = endPins[i];
    pinMode(currentEndPin, OUTPUT);
    digitalWrite(currentEndPin, LOW);
    for (int j = i + 1 ; j < pinCount; j++) {
      pinMode(endPins[j], INPUT_PULLUP);
      int value = digitalRead(endPins[j]);
      if (value == LOW) {
        sprintf(strbuf, "End Pin %d is shorted to %d", currentEndPin, endPins[j]);    
        Serial.println(strbuf); 
        shorted = true;
        break;
      }
    }
    pinMode(currentEndPin  , INPUT_PULLUP);
    if (shorted) {
      break;
    }
  }
  return shorted;
}

void initPins() {
    for (int i = 0; i < pinCount - 1; i++) {
      pinMode(startPins[i], INPUT_PULLUP);
      pinMode(endPins[i], INPUT_PULLUP);
    }
    pinMode(switchPin, INPUT_PULLUP);

}

int checkSolve() {
    int solved = 0;
    char strbuf [50];
    for (int i = 0; i < pinCount; i++) {
      int currentStartPin = startPins[i];
      pinMode(currentStartPin, OUTPUT);
      digitalWrite(currentStartPin, LOW);   
      pinMode(endPins[i], INPUT_PULLUP);
      int value = digitalRead(endPins[i]);
      pinMode(currentStartPin, INPUT_PULLUP);
      sprintf(strbuf, "Pin %d to %d set to %d", currentStartPin, endPins[i], value);
      Serial.println(strbuf);   
      if (value == LOW) {
        solved++;
      }
    }
    return solved;
}

bool switchCheck() {
      int value = digitalRead(switchPin);
      if (value == LOW) {
        return true;
      }
      return false;
}

void displayMessage(char* msg, int textSize) {
  display.clearDisplay();
  display.setCursor(0,0);             // Start at top-left corner
  display.setTextSize(textSize);             // Draw 2X-scale text
  display.setTextColor(SSD1306_WHITE);
  display.print(msg);
  display.display();
  delay(5000);
  display.clearDisplay();
  display.display();  
}

void displayMessage(const __FlashStringHelper *msg, int textSize) {
  display.clearDisplay();
  display.setCursor(0,0);             // Start at top-left corner
  display.setTextSize(textSize);             // Draw 2X-scale text
  display.setTextColor(SSD1306_WHITE);
  display.print(msg);
  display.display();
  delay(8000);
  display.clearDisplay();
  display.display();  
}

void displayEmoji() {
  display.clearDisplay();
  display.setCursor(0,0);             // Start at top-left corner
  display.drawBitmap(0, 0, epd_bitmap_kingcharlescypher, 128, 64, 1);
  display.display();
  delay(5000);
  display.clearDisplay();
  display.display();

}

void setup() {
  // put your setup code here, to run once:
  Serial.begin( 9600 );
  initPins();

  // SSD1306_SWITCHCAPVCC = generate display voltage from 3.3V internally
  if(!display.begin(SSD1306_SWITCHCAPVCC, SCREEN_ADDRESS)) {
    Serial.println(F("SSD1306 allocation failed"));
    for(;;); // Don't proceed, loop forever
  }

  // Show initial display buffer contents on the screen --
  // the library initializes this with an Adafruit splash screen.
  //display.display();
  //delay(2000); // Pause for 2 seconds

  //displayEmoji();
  //delay(5000);
  // Clear the buffer
  Serial.println(F("Clear Display"));
  display.clearDisplay();
  display.print("ready");
  display.display();
}

void loop() {
  // put your main code here, to run repeatedly:
  bool swChk = switchCheck();
  if (!swChk)
  {
    delay(100);
    return;
  }
  bool shorted = isShorted();
  if (shorted) {
    Serial.println(F("Shorted"));
    displayMessage(F("Short Detected!\nPlease remove wires\nand try again.\nEach red port must\nconnect to a black port."), 1);
    return;
  }
  int solved = checkSolve();
  if (solved == 0) {
    cycles = 0;
    Serial.println(F("No wires connected correctly"));
    displayMessage(F("No wires connected\ncorrectly.\nConnect the wires\nbetween the black and\nred ports.\nNo wire should cross\nanother.\n"), 1);
    return;
  }
  if (solved == 2) {
    displayMessage(F("Incorrect.\nHint: Not all wires\ngo in a straight\nline."), 1);
    return;
  }
  if (solved >= pinCount-1) {
    Serial.println(F("Solved"));
    displayEmoji();
    initPins();
    cycles=0;
    return;
  } 
  Serial.println(cycles);
  if(cycles == 0  || cycles % 11 != 0) {
    char* msg = "Incorrect!\nTry again";
    Serial.println(msg);    
    displayMessage(msg, 2);
    cycles++;
    return;
  }
  char strbuf [50];
  sprintf(strbuf, "%d of %d\nwires are\ncorrect", solved, pinCount);
  Serial.println(strbuf);    
  displayMessage(strbuf, 2);
  cycles++;
}
